## esp-idf/demo1/sdkconfig.defaults
```kconfig
#-----------------------------------------------------------------------------
# Default overrides used when running `make menuconfig` for the first time
# (this file has no effect if `sdkconfig` already exists)
#
# Example inits are commented out
#-----------------------------------------------------------------------------

#-----------------------------------------------------------------------------
# Menu: Serial flasher config --> Default serial port
# CONFIG_ESPTOOLPY_PORT="/dev/ttyUSB0"
CONFIG_ESPTOOLPY_PORT="COM16"

#-----------------------------------------------------------------------------
# Menu: Component config --> ESP32-specific --> CPU frequency
CONFIG_ESP32_DEFAULT_CPU_FREQ_240=y
CONFIG_ESP32_DEFAULT_CPU_FREQ_MHZ=240

#-----------------------------------------------------------------------------
# Menu: Component config --> FreeRTOS --> Tick rate (Hz)
CONFIG_FREERTOS_HZ=1000

#-----------------------------------------------------------------------------
```
